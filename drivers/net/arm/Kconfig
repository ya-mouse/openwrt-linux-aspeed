## drivers/net/arm/Kconfig
```kconfig
#
# Acorn Network device configuration
#  These are for Acorn's Expansion card network interfaces
#
config ARM_AM79C961A
	bool "ARM EBSA110 AM79C961A support"
	depends on ARM && ARCH_EBSA110
	select CRC32
	help
	  If you wish to compile a kernel for the EBSA-110, then you should
	  always answer Y to this.

config ARM_ETHER1
	tristate "Acorn Ether1 support"
	depends on ARM && ARCH_ACORN
	help
	  If you have an Acorn system with one of these (AKA25) network cards,
	  you should say Y to this option if you wish to use it with Linux.

config ARM_ETHER3
	tristate "Acorn/ANT Ether3 support"
	depends on ARM && ARCH_ACORN
	help
	  If you have an Acorn system with one of these network cards, you
	  should say Y to this option if you wish to use it with Linux.

config ARM_ETHERH
	tristate "I-cubed EtherH/ANT EtherM support"
	depends on ARM && ARCH_ACORN
	select CRC32
	help
	  If you have an Acorn system with one of these network cards, you
	  should say Y to this option if you wish to use it with Linux.

config ARM_AT91_ETHER
	tristate "AT91RM9200 Ethernet support"
	depends on ARM && ARCH_AT91RM9200
	select MII
	help
	  If you wish to compile a kernel for the AT91RM9200 and enable
	  ethernet support, then you should always answer Y to this.

config EP93XX_ETH
	tristate "EP93xx Ethernet support"
	depends on ARM && ARCH_EP93XX
	select MII
	help
	  This is a driver for the ethernet hardware included in EP93xx CPUs.
	  Say Y if you are building a kernel for EP93xx based devices.

config IXP4XX_ETH
	tristate "Intel IXP4xx Ethernet support"
	depends on ARM && ARCH_IXP4XX && IXP4XX_NPE && IXP4XX_QMGR
	select MII
	help
	  Say Y here if you want to use built-in Ethernet ports
	  on IXP4xx processor.

config ASTMAC100
	tristate "Aspeed MAC 100 support"
	depends on NET_ETHERNET && ARCH_ASPEED


config AST_PHY_ADDR
	int "AST200 MAC MII PHY Address" if ASTMAC100
	default "31"


config ASTMAC100_NAPI
	bool "Use NAPI RX polling "
	depends on ASTMAC100
        help
          NAPI is a new driver API designed to reduce CPU and interrupt load
          when the driver is receiving lots of packets from the card. It is
          still somewhat experimental and thus not yet enabled by default.

          If your estimated Rx load is 10kpps or more, or if the card will be
          deployed on potentially unfriendly networks (e.g. in a firewall),
          then say Y here.

          See <file:Documentation/networking/NAPI_HOWTO.txt> for more
          information.

          If in doubt, say N.
```
